## package/uclient-fetch/Config.in
```kconfig
config BR2_PACKAGE_UCLIENT_FETCH
    bool "uclient-fetch"
    help
        A minimal HTTP/HTTPS client used by OpenWrt, based on libustream-ssl.

        https://git.openwrt.org/project/ustream-ssl.git
```
